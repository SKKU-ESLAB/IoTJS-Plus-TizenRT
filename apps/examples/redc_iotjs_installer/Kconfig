## apps/examples/redc_iotjs_installer/Kconfig
```kconfig
#
# For a description of the syntax of this configuration file,
# see kconfig-language at https://www.kernel.org/doc/Documentation/kbuild/kconfig-language.txt
#

config EXAMPLES_REDC_IOTJS_INSTALLER
	bool "REDC IoT.js Installer"
	default n
	select ENABLE_IOTJS
	---help---
		Enable REDC IoT.js Installer
```

## apps/examples/redc_iotjs_launcher/Kconfig
```kconfig
#
# For a description of the syntax of this configuration file,
# see kconfig-language at https://www.kernel.org/doc/Documentation/kbuild/kconfig-language.txt
#

config EXAMPLES_REDC_IOTJS_LAUNCHER
	bool "REDC IoT.js Launcher"
	default n
	select ENABLE_IOTJS
	---help---
		Enable REDC IoT.js Launcher

config USER_ENTRYPOINT
  string
  default "iotjs_installer_main" if ENTRY_REDC_IOTJS_LAUNCHER
```

## apps/examples/redc_wifi_connector/Kconfig
```kconfig
#
# For a description of the syntax of this configuration file,
# see kconfig-language at https://www.kernel.org/doc/Documentation/kbuild/kconfig-language.txt
#

config EXAMPLES_REDC_WIFI_CONNECTOR
	bool "REDC Wi-fi Connector"
	default n
	depends on WIFI_MANAGER
	---help---
		Enable REDC Wi-Fi Connector
```
